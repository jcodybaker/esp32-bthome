## examples/scanner/sdkconfig.defaults
```kconfig
# Bluetooth configuration
CONFIG_BT_ENABLED=y
CONFIG_BT_BLUEDROID_ENABLED=y
CONFIG_BT_CLASSIC_ENABLED=n
CONFIG_BT_BLE_ENABLED=y

# Reduce memory usage by disabling BT Classic
CONFIG_BT_CONTROLLER_ONLY=n

# Enable BLE scanning
CONFIG_BT_NIMBLE_ENABLED=n
```
